## boards/shields/piantor/Kconfig.shield
```kconfig
config SHIELD_PIANTOR
    bool "Corne 2.1 (sparkfun_pro_micro_rp2040)"
    select ZMK
    select ZMK_USB
    help
      Corne 2.1 shield configuration for SparkFun Pro Micro RP2040.
```
